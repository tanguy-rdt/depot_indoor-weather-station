## CMakeLists.txt
```
cmake_minimum_required(VERSION 3.20)

project(iws VERSION 1.0
            DESCRIPTION "Indoor Weather Station"
            LANGUAGES CXX C)

set(CMAKE_CXX_STANDARD 20)
set(CMAKE_C_STANDARD 11)
set(CMAKE_CXX_STANDARD_REQUIRED ON)
set(CMAKE_C_STANDARD_REQUIRED ON)

set(ROOT_DIR         "${CMAKE_SOURCE_DIR}")
set(THIRD_PARTY_DIR  "${ROOT_DIR}/third-party")
set(CONFIG_DIR       "${ROOT_DIR}/config")
set(CMAKE_DIR        "${ROOT_DIR}/cmake")

option(IWS_SIMU "IWS simulator target" OFF)
option(IWS_MINIMAL   "IWS minimal (zephyr) target" OFF)

if(IWS_SIMU)
    include(${CMAKE_DIR}/iws_simu.cmake)
elseif(IWS_MINIMAL)
    include(${CMAKE_DIR}/iws_minimal.cmake)
else()
    message(FATAL_ERROR "No valid target specified. Use -DIWS_SIMU or -DIWS_MINIMAL")
endif()

# BUILD PATH
message(STATUS "BUILD_DIR: ${CMAKE_BINARY_DIR}")
```

## prj.conf
```kconfig
CONFIG_MAIN_STACK_SIZE=2048

CONFIG_LOG=y
CONFIG_DISPLAY_LOG_LEVEL_ERR=y

CONFIG_SHELL=y

# C++ Language Support
#
CONFIG_CPP=y
CONFIG_STD_CPP98=n
CONFIG_STD_CPP11=n
CONFIG_STD_CPP14=n
CONFIG_STD_CPP17=n
CONFIG_STD_CPP2A=n
CONFIG_STD_CPP20=y
CONFIG_STD_CPP2B=n
CONFIG_REQUIRES_FULL_LIBCPP=n
CONFIG_MINIMAL_LIBCPP=y
CONFIG_GLIBCXX_LIBCPP=n
CONFIG_EXTERNAL_LIBCPP=n
CONFIG_EXTERNAL_MODULE_LIBCPP=n
CONFIG_CPP_MAIN=n
# end of C++ Language Support
```

## src/main.cpp
```c
#ifdef ZEPHYR
#include <zephyr/kernel.h>
#include <zephyr/logging/log.h>

#define LOG_LEVEL LOG_LEVEL_DBG
LOG_MODULE_REGISTER(main);
#endif

#include "log.h"

#include "hal.h"
#include "proxy/proxy.h"
#include "gui.h"
#include "event_manager/event_manager.h"
#include <unistd.h>

#include "lvgl.h"

using namespace proxy;
using namespace gui;

int main() {
   lv_init();

   EventManager eventManager;

   #ifdef DEBUG
      Log::level(LogLevel::Debug);
   #else
      Log::level(LogLevel::Info);
   #endif

   Hal hal(&eventManager);
   hal.init();

   Proxy proxy(&hal, &eventManager);

   Gui gui(&proxy, &eventManager);
   gui.init();

   while (true) {
      uint32_t ms_delay = lv_timer_handler();
      usleep(ms_delay * 1000);
   }

   return 0;
}
```
